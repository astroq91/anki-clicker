## src/build/Kconfig/arch/Kconfig.tmp
```kconfig
# Load Zephyr Arch Kconfig descriptions.
osource "/home/astro/zephyr-mcuboot/zephyr/arch/rx/Kconfig"
osource "/home/astro/zephyr-mcuboot/zephyr/arch/x86/Kconfig"
osource "/home/astro/zephyr-mcuboot/zephyr/arch/xtensa/Kconfig"
osource "/home/astro/zephyr-mcuboot/zephyr/arch/sparc/Kconfig"
osource "/home/astro/zephyr-mcuboot/zephyr/arch/riscv/Kconfig"
osource "/home/astro/zephyr-mcuboot/zephyr/arch/posix/Kconfig"
osource "/home/astro/zephyr-mcuboot/zephyr/arch/openrisc/Kconfig"
osource "/home/astro/zephyr-mcuboot/zephyr/arch/mips/Kconfig"
osource "/home/astro/zephyr-mcuboot/zephyr/arch/arm64/Kconfig"
osource "/home/astro/zephyr-mcuboot/zephyr/arch/arm/Kconfig"
osource "/home/astro/zephyr-mcuboot/zephyr/arch/arc/Kconfig"
```

## src/build/Kconfig/boards/Kconfig.defconfig
```kconfig
# Load Zephyr board defconfig descriptions.
osource "/home/astro/zephyr-mcuboot/zephyr/boards/nordic/nrf52840dk/Kconfig.defconfig"
```

## src/build/Kconfig/boards/Kconfig.nrf52840dk
```kconfig
# Load board Kconfig descriptions.
osource "/home/astro/zephyr-mcuboot/zephyr/boards/nordic/nrf52840dk/Kconfig.nrf52840dk"
```

## src/build/Kconfig/boards/Kconfig.sysbuild
```kconfig
# Load Sysbuild board Kconfig descriptions.
osource "/home/astro/zephyr-mcuboot/zephyr/boards/nordic/nrf52840dk/Kconfig.sysbuild"
```

## src/build/Kconfig/soc/Kconfig
```kconfig
# Load Zephyr SoC Kconfig descriptions.
osource "/home/astro/zephyr-mcuboot/zephyr/soc/xlnx/zynqmp/Kconfig"
osource "/home/astro/zephyr-mcuboot/zephyr/soc/xlnx/zynq7000/Kconfig"
osource "/home/astro/zephyr-mcuboot/zephyr/soc/xlnx/versalnet/Kconfig"
osource "/home/astro/zephyr-mcuboot/zephyr/soc/xlnx/versal2/Kconfig"
osource "/home/astro/zephyr-mcuboot/zephyr/soc/xlnx/versal/Kconfig"
osource "/home/astro/zephyr-mcuboot/zephyr/soc/xen/Kconfig"
osource "/home/astro/zephyr-mcuboot/zephyr/soc/wch/ch32v/Kconfig"
osource "/home/astro/zephyr-mcuboot/zephyr/soc/ti/simplelink/Kconfig"
osource "/home/astro/zephyr-mcuboot/zephyr/soc/ti/mspm0/Kconfig"
osource "/home/astro/zephyr-mcuboot/zephyr/soc/ti/lm3s6965/Kconfig"
osource "/home/astro/zephyr-mcuboot/zephyr/soc/ti/k3/Kconfig"
osource "/home/astro/zephyr-mcuboot/zephyr/soc/telink/tlsr/Kconfig"
osource "/home/astro/zephyr-mcuboot/zephyr/soc/syna/sr100/Kconfig"
osource "/home/astro/zephyr-mcuboot/zephyr/soc/starfive/jh71xx/Kconfig"
osource "/home/astro/zephyr-mcuboot/zephyr/soc/st/stm32/Kconfig"
osource "/home/astro/zephyr-mcuboot/zephyr/soc/snps/qemu_arc/Kconfig"
osource "/home/astro/zephyr-mcuboot/zephyr/soc/snps/nsim/arc_v/Kconfig"
osource "/home/astro/zephyr-mcuboot/zephyr/soc/snps/nsim/arc_classic/Kconfig"
osource "/home/astro/zephyr-mcuboot/zephyr/soc/snps/hsdk4xd/Kconfig"
osource "/home/astro/zephyr-mcuboot/zephyr/soc/snps/hsdk/Kconfig"
osource "/home/astro/zephyr-mcuboot/zephyr/soc/snps/emsk/Kconfig"
osource "/home/astro/zephyr-mcuboot/zephyr/soc/snps/emsdp/Kconfig"
osource "/home/astro/zephyr-mcuboot/zephyr/soc/snps/arc_iot/Kconfig"
osource "/home/astro/zephyr-mcuboot/zephyr/soc/silabs/Kconfig"
osource "/home/astro/zephyr-mcuboot/zephyr/soc/sifli/sf32/Kconfig"
osource "/home/astro/zephyr-mcuboot/zephyr/soc/sifive/sifive_freedom/Kconfig"
osource "/home/astro/zephyr-mcuboot/zephyr/soc/sensry/Kconfig"
osource "/home/astro/zephyr-mcuboot/zephyr/soc/rockchip/Kconfig"
osource "/home/astro/zephyr-mcuboot/zephyr/soc/renode/riscv_virtual/Kconfig"
osource "/home/astro/zephyr-mcuboot/zephyr/soc/renode/cortex_r8_virtual/Kconfig"
osource "/home/astro/zephyr-mcuboot/zephyr/soc/renesas/smartbond/Kconfig"
osource "/home/astro/zephyr-mcuboot/zephyr/soc/renesas/rz/Kconfig"
osource "/home/astro/zephyr-mcuboot/zephyr/soc/renesas/rx/Kconfig"
osource "/home/astro/zephyr-mcuboot/zephyr/soc/renesas/rcar/Kconfig"
osource "/home/astro/zephyr-mcuboot/zephyr/soc/renesas/ra/Kconfig"
osource "/home/astro/zephyr-mcuboot/zephyr/soc/realtek/fingerprint/Kconfig"
osource "/home/astro/zephyr-mcuboot/zephyr/soc/realtek/ec/Kconfig"
osource "/home/astro/zephyr-mcuboot/zephyr/soc/realtek/bee/Kconfig"
osource "/home/astro/zephyr-mcuboot/zephyr/soc/realtek/ameba/Kconfig"
osource "/home/astro/zephyr-mcuboot/zephyr/soc/raspberrypi/rpi_pico/Kconfig"
osource "/home/astro/zephyr-mcuboot/zephyr/soc/quicklogic/eos_s3/Kconfig"
osource "/home/astro/zephyr-mcuboot/zephyr/soc/qemu/virt_riscv/Kconfig"
osource "/home/astro/zephyr-mcuboot/zephyr/soc/qemu/or1k/Kconfig"
osource "/home/astro/zephyr-mcuboot/zephyr/soc/qemu/malta/Kconfig"
osource "/home/astro/zephyr-mcuboot/zephyr/soc/openisa/rv32m1/Kconfig"
osource "/home/astro/zephyr-mcuboot/zephyr/soc/openhwgroup/cva6/Kconfig"
osource "/home/astro/zephyr-mcuboot/zephyr/soc/oct/osd32mp15x/Kconfig"
osource "/home/astro/zephyr-mcuboot/zephyr/soc/nxp/s32/Kconfig"
osource "/home/astro/zephyr-mcuboot/zephyr/soc/nxp/rw/Kconfig"
osource "/home/astro/zephyr-mcuboot/zephyr/soc/nxp/mcx/Kconfig"
osource "/home/astro/zephyr-mcuboot/zephyr/soc/nxp/lpc/Kconfig"
osource "/home/astro/zephyr-mcuboot/zephyr/soc/nxp/layerscape/Kconfig"
osource "/home/astro/zephyr-mcuboot/zephyr/soc/nxp/kinetis/Kconfig"
osource "/home/astro/zephyr-mcuboot/zephyr/soc/nxp/imxrt/Kconfig"
osource "/home/astro/zephyr-mcuboot/zephyr/soc/nxp/imx/Kconfig"
osource "/home/astro/zephyr-mcuboot/zephyr/soc/nuvoton/numicro/Kconfig"
osource "/home/astro/zephyr-mcuboot/zephyr/soc/nuvoton/numaker/Kconfig"
osource "/home/astro/zephyr-mcuboot/zephyr/soc/nuvoton/npcx/Kconfig"
osource "/home/astro/zephyr-mcuboot/zephyr/soc/nuvoton/npcm/Kconfig"
osource "/home/astro/zephyr-mcuboot/zephyr/soc/nordic/Kconfig"
osource "/home/astro/zephyr-mcuboot/zephyr/soc/neorv32/Kconfig"
osource "/home/astro/zephyr-mcuboot/zephyr/soc/native/inf_clock/Kconfig"
osource "/home/astro/zephyr-mcuboot/zephyr/soc/microchip/sam/sama7/Kconfig"
osource "/home/astro/zephyr-mcuboot/zephyr/soc/microchip/sam/sam_d5x_e5x/Kconfig"
osource "/home/astro/zephyr-mcuboot/zephyr/soc/microchip/pic64/Kconfig"
osource "/home/astro/zephyr-mcuboot/zephyr/soc/microchip/pic32c/pic32cz_ca/Kconfig"
osource "/home/astro/zephyr-mcuboot/zephyr/soc/microchip/pic32c/pic32cx_sg/Kconfig"
osource "/home/astro/zephyr-mcuboot/zephyr/soc/microchip/pic32c/pic32cm_pl/Kconfig"
osource "/home/astro/zephyr-mcuboot/zephyr/soc/microchip/pic32c/pic32cm_jh/Kconfig"
osource "/home/astro/zephyr-mcuboot/zephyr/soc/microchip/miv/Kconfig"
osource "/home/astro/zephyr-mcuboot/zephyr/soc/microchip/mec/Kconfig"
osource "/home/astro/zephyr-mcuboot/zephyr/soc/mediatek/mt8xxx/Kconfig"
osource "/home/astro/zephyr-mcuboot/zephyr/soc/lowrisc/opentitan/Kconfig"
osource "/home/astro/zephyr-mcuboot/zephyr/soc/litex/litex_vexriscv/Kconfig"
osource "/home/astro/zephyr-mcuboot/zephyr/soc/ite/ec/Kconfig"
osource "/home/astro/zephyr-mcuboot/zephyr/soc/intel/wildcat_lake/Kconfig"
osource "/home/astro/zephyr-mcuboot/zephyr/soc/intel/raptor_lake/Kconfig"
osource "/home/astro/zephyr-mcuboot/zephyr/soc/intel/panther_lake/Kconfig"
osource "/home/astro/zephyr-mcuboot/zephyr/soc/intel/lakemont/Kconfig"
osource "/home/astro/zephyr-mcuboot/zephyr/soc/intel/intel_socfpga_std/Kconfig"
osource "/home/astro/zephyr-mcuboot/zephyr/soc/intel/intel_socfpga/Kconfig"
osource "/home/astro/zephyr-mcuboot/zephyr/soc/intel/intel_niosv/Kconfig"
osource "/home/astro/zephyr-mcuboot/zephyr/soc/intel/intel_ish/Kconfig"
osource "/home/astro/zephyr-mcuboot/zephyr/soc/intel/intel_adsp/Kconfig"
osource "/home/astro/zephyr-mcuboot/zephyr/soc/intel/elkhart_lake/Kconfig"
osource "/home/astro/zephyr-mcuboot/zephyr/soc/intel/atom/Kconfig"
osource "/home/astro/zephyr-mcuboot/zephyr/soc/intel/apollo_lake/Kconfig"
osource "/home/astro/zephyr-mcuboot/zephyr/soc/intel/alder_lake/Kconfig"
osource "/home/astro/zephyr-mcuboot/zephyr/soc/infineon/psoc4/Kconfig"
osource "/home/astro/zephyr-mcuboot/zephyr/soc/infineon/edge/Kconfig"
osource "/home/astro/zephyr-mcuboot/zephyr/soc/infineon/cat3/Kconfig"
osource "/home/astro/zephyr-mcuboot/zephyr/soc/infineon/cat1c/Kconfig"
osource "/home/astro/zephyr-mcuboot/zephyr/soc/infineon/cat1b/Kconfig"
osource "/home/astro/zephyr-mcuboot/zephyr/soc/infineon/cat1a/Kconfig"
osource "/home/astro/zephyr-mcuboot/zephyr/soc/gd/gd32/Kconfig"
osource "/home/astro/zephyr-mcuboot/zephyr/soc/gaisler/leon3/Kconfig"
osource "/home/astro/zephyr-mcuboot/zephyr/soc/gaisler/gr716a/Kconfig"
osource "/home/astro/zephyr-mcuboot/zephyr/soc/focaltech/Kconfig"
osource "/home/astro/zephyr-mcuboot/zephyr/soc/espressif/Kconfig"
osource "/home/astro/zephyr-mcuboot/zephyr/soc/ene/kb1200/Kconfig"
osource "/home/astro/zephyr-mcuboot/zephyr/soc/ene/kb106x/Kconfig"
osource "/home/astro/zephyr-mcuboot/zephyr/soc/elan/em32f967/Kconfig"
osource "/home/astro/zephyr-mcuboot/zephyr/soc/egis/Kconfig"
osource "/home/astro/zephyr-mcuboot/zephyr/soc/efinix/sapphire/Kconfig"
osource "/home/astro/zephyr-mcuboot/zephyr/soc/cdns/xtensa_sample_controller/Kconfig"
osource "/home/astro/zephyr-mcuboot/zephyr/soc/cdns/swerv/Kconfig"
osource "/home/astro/zephyr-mcuboot/zephyr/soc/cdns/sample_controller32/Kconfig"
osource "/home/astro/zephyr-mcuboot/zephyr/soc/cdns/dc233c/Kconfig"
osource "/home/astro/zephyr-mcuboot/zephyr/soc/brcm/bcmvk/Kconfig"
osource "/home/astro/zephyr-mcuboot/zephyr/soc/brcm/bcm2712/Kconfig"
osource "/home/astro/zephyr-mcuboot/zephyr/soc/brcm/bcm2711/Kconfig"
osource "/home/astro/zephyr-mcuboot/zephyr/soc/blackberry/qnxhv_vm/Kconfig"
osource "/home/astro/zephyr-mcuboot/zephyr/soc/bflb/Kconfig"
osource "/home/astro/zephyr-mcuboot/zephyr/soc/atmel/sam0/Kconfig"
osource "/home/astro/zephyr-mcuboot/zephyr/soc/atmel/sam/Kconfig"
osource "/home/astro/zephyr-mcuboot/zephyr/soc/aspeed/Kconfig"
osource "/home/astro/zephyr-mcuboot/zephyr/soc/arm/Kconfig"
osource "/home/astro/zephyr-mcuboot/zephyr/soc/arm/beetle/Kconfig"
osource "/home/astro/zephyr-mcuboot/zephyr/soc/antmicro/myra/Kconfig"
osource "/home/astro/zephyr-mcuboot/zephyr/soc/andestech/Kconfig"
osource "/home/astro/zephyr-mcuboot/zephyr/soc/amd/acp_6_0/Kconfig"
osource "/home/astro/zephyr-mcuboot/zephyr/soc/ambiq/Kconfig"
osource "/home/astro/zephyr-mcuboot/zephyr/soc/allwinner/sun8i_h3/Kconfig"
osource "/home/astro/zephyr-mcuboot/zephyr/soc/alif/ensemble/Kconfig"
osource "/home/astro/zephyr-mcuboot/zephyr/soc/aesc/Kconfig"
osource "/home/astro/zephyr-mcuboot/zephyr/soc/adi/max32/Kconfig"
```
